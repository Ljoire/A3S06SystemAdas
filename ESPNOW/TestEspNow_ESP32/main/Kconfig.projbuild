## ESPNOW/TestEspNow_ESP32/main/Kconfig.projbuild
```kconfig
menu "Configuration ESPNOW ADAS"

    config ESPNOW_WIFI_MODE
        int "Mode WiFi"
        default 1
        help
            Mode WiFi pour ESPNOW (1 = Station)

    config ESPNOW_WIFI_IF
        int "Interface WiFi"
        default 0
        help
            Interface WiFi (0 = STA)

    config ESPNOW_CHANNEL
        int "Canal WiFi"
        default 1
        range 1 13
        help
            Canal WiFi pour la communication ESPNOW

    config ESPNOW_PMK
        string "Clé primaire ESPNOW"
        default "pmk1234567890123"
        help
            Clé principale ESPNOW (16 caractères)

    config ESPNOW_LMK
        string "Clé locale ESPNOW"
        default "lmk1234567890123"
        help
            Clé locale ESPNOW (16 caractères)

    config ESPNOW_QUEUE_SIZE
        int "Taille de la file d'attente ESPNOW"
        default 6
        range 1 64
        help
            Nombre maximal de messages ESPNOW dans la file d'attente

    config ESPNOW_ENABLE_LONG_RANGE
        bool "Activer longue portée"
        default n
        help
            Active le mode longue portée pour ESPNOW

    config ESPNOW_ENABLE_POWER_SAVE
        bool "Activer économie d'énergie"
        default n
        help
            Active le mode économie d'énergie

endmenu
```
